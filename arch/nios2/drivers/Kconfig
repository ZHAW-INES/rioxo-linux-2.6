## arch/nios2/drivers/Kconfig
```kconfig
# Platfrom drivers configuration

menu "Additional NiosII Device Drivers"

source "arch/nios2/drivers/pci/Kconfig"

config ALTERA_REMOTE_UPDATE
	bool "Remote update support"
	depends on NIOS2
	default N
	help
	  This driver provides support for automatic reconfiguration of a
	  CycloneIII FPGA (Possibly others too).

choice ALTERA_REMOTE_UPDATE_FLASH_WIDTH
	prompt "FPGA configuration flash data width"
	depends on ALTERA_REMOTE_UPDATE
	default ALTERA_REMOTE_UPDATE_FLASH_WIDTH_8
	help
	  The ALTREMOTE_UPDATE megafunction requires that you only provide it
	  the 22 highest-order bits of a 24-bit address offset.

	  This options controls the value by which the address offset of the
	  FPGA configuration image is shifted depending on the data width of
	  the flash where your image is stored.

	  EPCS flash data witdh is usually 8 bit
	  CFI flash data width is usually 16 bit

config ALTERA_REMOTE_UPDATE_FLASH_WIDTH_8
	bool "8 bits (shift address by 2)"
config ALTERA_REMOTE_UPDATE_FLASH_WIDTH_16
	bool "16 bits (shift address by 3)"
endchoice

config PIO_DEVICES
	bool "Enable NiosII PIO driver"
	default n
	depends on (ALTERA_STRATIX || ALTERA_STRATIX_PRO || ALTERA_CYCLONE)
	help
	  This enables example code to support leds, and seven segment
	  display as PIO devices. Once enabled, the kernel will show a
	  counter (increas once a second) on these devices.

endmenu
```

## drivers/usb/isp1763/Kconfig
```kconfig
#
#

comment "Enable Host or Gadget support to see ISP1763 options"
	depends on !USB && USB_GADGET=n

menuconfig USB_ISP1763
	tristate "ISP 1763A highspeed dual role controller support"
	depends on (USB || USB_GADGET)
	---help---
	  Support for ST Ericsson ISP1763A USB OTG Controller.
	  Allows for host only, peripheral ony and limited OTG support.


if USB_ISP1763

config USB_ISP1763_UDC
	select USB_GADGET_SELECTED
	tristate

config USB_ISP1763_HCD
	tristate

choice
	prompt "ISP1763 controller drivers"
	depends on USB_ISP1763
	---help---
	  Marker for multiple choices for the driver operational mode:
	  host+periperhal or [periperhal|host]-only modes.

config USB_ISP1763_OTG
	depends on USB_ISP1763
	tristate 'ISP1763 OTG (host+device auto-select) support'
	select USB_ISP1763_UDC
	select USB_ISP1763_HCD
	---help---
	  Limited OTG support for ISP1763; enables detection of ID signal and
	  automatic switching between host and device controller mode. Does
	  not include HRP and SRP support.

	  This option will build the drivers for both host and peripheral
	  controller.

config USB_ISP1763_UDC_SELECT
	depends on USB_ISP1763
	depends on USB_GADGET
	select USB_GADGET_DUALSPEED
	select USB_ISP1763_FUNCTION_SELECTED
	select USB_ISP1763_UDC
	tristate 'ISP1763 UDC peripheral-only support'
	---help---
	   This flag turns on only the Support for peripheral controller
	   functionality of the ISP1763

config USB_ISP1763_HCD_SELECT
	depends on USB_ISP1763
	select USB_ISP1763_HCD
	tristate 'ISP1763 HCD host-only support'
	---help---
	   This flag turns on only the Support for host controller
	   functionality of the ISP1763

endchoice

endif
```
